## external/Config.in
```kconfig
# SPDX-License-Identifier: GPL-2.0-or-later
# Copyright (C) 2026 Corley S.r.l.
menu "Luckfox Lyra Plus (RK3506G2)"

comment "Dipendenze binarie vendor"

config BR2_LYRA_RKBIN_DIR
	string "percorso del checkout rkbin"
	default "vendor/rkbin"
	help
	  Percorso di un checkout del repository Rockchip 'rkbin'. Se
	  relativo, e' risolto rispetto alla radice di questo repository,
	  quindi il default punta al submodule 'vendor'.

	  Da qui vengono presi blob e tool che NON sono ricompilabili dai
	  sorgenti e che quindi non vivono in questo repository:

	    bin/rk35/rk3506_ddr_750MHz_v1.04.bin   init DDR (CODE471 + FlashData)
	    bin/rk35/rk3506_usbplug_v1.02.bin      CODE472
	    bin/rk35/rk3506_tee_v1.25.bin          OP-TEE
	    tools/boot_merger                      assembla MiniLoaderAll.bin
	    tools/mkimage                          genera i FIT
	    RKBOOT/RK3506MINIALL.ini               descrittore loader
	    RKTRUST/RK3506TOS.ini                  descrittore OP-TEE

	  Il submodule 'vendor' (github.com/wdalmut/rk3506-vendor-kit) li
	  contiene gia', estratti dall'SDK Luckfox v1.4 al tag
	  linux-6.1-stan-rkr4.2 (sha 32ccaf811ae70ce050aa810869c63c2b34324d59).
	  Puntare a un checkout rkbin diverso e' comunque supportato: basta
	  un percorso assoluto.

	  post-image.sh verifica lo sha256 dei blob contro
	  board/lyra-plus/rkbin.sha256 e si ferma se non corrispondono.
	  Per sbloccare volontariamente: LYRA_ALLOW_RKBIN_MISMATCH=1.

	  ATTENZIONE: 'u-boot/make.sh' pretende rkbin come directory
	  fratello (controlla '../rkbin' e aborta se manca), e la catena ci
	  scrive dentro (spl.sh crea una dir 'tmp' nella radice di rkbin).
	  post-image.sh ne fa quindi una COPIA di lavoro in
	  $(BUILD_DIR)/rkbin: il checkout puntato qui resta intatto e puo'
	  essere montato read-only.

config BR2_LYRA_PACKTOOL_DIR
	string "percorso dei tool Rockchip di packaging (afptool, rkImageMaker)"
	default "vendor/packtool"
	help
	  Directory che contiene 'afptool' e 'rkImageMaker', usati per
	  produrre update.img. Come sopra, un percorso relativo e' risolto
	  rispetto alla radice del repository.

	  Non stanno in rkbin: nell'SDK sono nel repository 'tools', sotto
	  tools/linux/Linux_Pack_Firmware/rockdev. Il submodule 'vendor' li
	  raccoglie in packtool/.

	  Se lasciato vuoto, o se i due binari non sono presenti,
	  post-image.sh SALTA update.img con un avviso esplicito e
	  produce comunque tutti gli altri artefatti. Le immagini per
	  partizione restano flashabili singolarmente con rkdeveloptool.

comment "Applicazioni"

source "$BR2_EXTERNAL_LYRA_PLUS_PATH/package/hello-lyra/Config.in"

endmenu
```

## external/configs/lyra_plus_mainline_initramfs_defconfig
```kconfig
BR2_arm=y
BR2_cortex_a7=y
BR2_ARM_FPU_NEON_VFPV4=y
BR2_PACKAGE_HOST_LINUX_HEADERS_CUSTOM_6_19=y
BR2_GCC_VERSION_13_X=y
BR2_GLOBAL_PATCH_DIR="$(BR2_EXTERNAL_LYRA_PLUS_PATH)/patches $(BR2_EXTERNAL_LYRA_PLUS_PATH)/board/lyra-plus/patches"
BR2_TARGET_GENERIC_HOSTNAME="lyra-plus"
BR2_TARGET_GENERIC_ISSUE="Luckfox Lyra Plus (RK3506G2) - mainline 6.19 initramfs bring-up"
BR2_TARGET_GENERIC_ROOT_PASSWD="lyra"
BR2_TARGET_GENERIC_GETTY_PORT="ttyS0"
BR2_ROOTFS_OVERLAY="$(BR2_EXTERNAL_LYRA_PLUS_PATH)/board/lyra-plus/rootfs_overlay"
BR2_ROOTFS_POST_BUILD_SCRIPT="$(BR2_EXTERNAL_LYRA_PLUS_PATH)/board/lyra-plus/post-build.sh"
BR2_ROOTFS_POST_IMAGE_SCRIPT="$(BR2_EXTERNAL_LYRA_PLUS_PATH)/board/lyra-plus/post-image.sh"
BR2_LINUX_KERNEL=y
BR2_LINUX_KERNEL_CUSTOM_GIT=y
BR2_LINUX_KERNEL_CUSTOM_REPO_URL="https://github.com/wdalmut/rk3506-kernel-upstream.git"
BR2_LINUX_KERNEL_CUSTOM_REPO_VERSION="c3a99014e11e7fe3a35860aadb16d7d4b5bb24d0"
BR2_LINUX_KERNEL_DEFCONFIG="multi_v7"
BR2_LINUX_KERNEL_CONFIG_FRAGMENT_FILES="$(BR2_EXTERNAL_LYRA_PLUS_PATH)/board/lyra-plus/linux-mainline.config"
BR2_LINUX_KERNEL_DTS_SUPPORT=y
BR2_LINUX_KERNEL_INTREE_DTS_NAME="rockchip/rk3506g-luckfox-lyra-plus"
# BR2_PACKAGE_IFUPDOWN_SCRIPTS is not set
BR2_TARGET_ROOTFS_INITRAMFS=y
# BR2_TARGET_ROOTFS_TAR is not set
BR2_TARGET_UBOOT=y
BR2_TARGET_UBOOT_BUILD_SYSTEM_KCONFIG=y
BR2_TARGET_UBOOT_CUSTOM_GIT=y
BR2_TARGET_UBOOT_CUSTOM_REPO_URL="https://github.com/wdalmut/rk3506-uboot.git"
BR2_TARGET_UBOOT_CUSTOM_REPO_VERSION="1625f78b6dcf9fe401d447da79132b7bc6804538"
BR2_TARGET_UBOOT_BOARD_DEFCONFIG="rk3506_luckfox"
BR2_TARGET_UBOOT_CONFIG_FRAGMENT_FILES="$(BR2_EXTERNAL_LYRA_PLUS_PATH)/board/lyra-plus/uboot.config"
BR2_TARGET_UBOOT_NEEDS_DTC=y
BR2_TARGET_UBOOT_NEEDS_OPENSSL=y
BR2_TARGET_UBOOT_SPL=y
BR2_PACKAGE_HOST_RK_RESOURCE_TOOL=y
BR2_PACKAGE_HELLO_LYRA=y
```

## external/package/hello-lyra/Config.in
```kconfig
config BR2_PACKAGE_HELLO_LYRA
	bool "hello-lyra"
	depends on BR2_PACKAGE_HOST_GO_TARGET_ARCH_SUPPORTS
	help
	  Applicazione di verifica per Luckfox Lyra Plus (RK3506G2).

	  Stampa un banner e legge dal sistema quattro cose che dicono se il
	  porting ha funzionato davvero:
	    - modello board da /proc/device-tree/model
	    - uptime da /proc/uptime
	    - memoria da /proc/meminfo
	    - partizioni MTD da /proc/mtd

	  Scritta in Go, cross-compilata per ARMv7 (GOARCH=arm GOARM=7,
	  entrambi dedotti da Buildroot) con CGO_ENABLED=0: il binario e'
	  statico e non dipende dalla libc del rootfs.

	  Avviata al boot da /etc/init.d/S99hello, installato dall'overlay
	  di board.

comment "hello-lyra richiede una architettura supportata da Go"
	depends on !BR2_PACKAGE_HOST_GO_TARGET_ARCH_SUPPORTS
```

## external/package/rk-resource-tool/Config.in
```kconfig
# SPDX-License-Identifier: GPL-2.0-or-later
# Copyright (C) 2026 Corley S.r.l.
config BR2_PACKAGE_HOST_RK_RESOURCE_TOOL
	bool "host resource_tool (Rockchip)"
	help
	  `resource_tool` di Rockchip, compilato per l'host.

	  post-image.sh ne ha bisogno per produrre resource.img, che non e'
	  opzionale: con CONFIG_ROCKCHIP_RESOURCE_IMAGE=y (attivo nel
	  defconfig U-Boot di questa board) U-Boot prende il DTB del kernel
	  da resource.img e NON dal nodo `fdt` del FIT.

	  Serve solo ai kernel che non lo compilano da se'. Il kernel vendor
	  6.1 lo costruisce in scripts/ perche' lo dichiara
	  hostprogs-always-$(CONFIG_ARCH_ROCKCHIP); mainline non ha ne' la
	  riga ne' il file. post-image.sh preferisce sempre il binario del
	  kernel, se c'e', e ricade su questo.

	  Il sorgente e' vendorizzato in
	  package/rk-resource-tool/src/resource_tool.c: provenienza, sha256 e
	  licenza (GPL-2.0+, Fuzhou Rockchip) in package/rk-resource-tool/README.md.

	  Attivarlo non cambia il target: e' un host package.
```
